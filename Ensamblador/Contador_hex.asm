; ZONA DE DATOS ************************
 __CONFIG _CP_OFF &_WDT_OFF &_PWRTE_ON &_XT_OSC
 LIST P=PIC16F84A
 INCLUDE <P16F84A.INC>
;ZONA DE VARIABLES *********************
 CBLOCK	0X0C				;SE INICIALIZA LA MEMORIA C
	NUMERO				;VARIABLE QUE LLEVE EL CONTADOR DE 0-9 Y A-F
	CONTADOR			;LLEVA EL TIEMPO EN CICLOS DE RELOJ
 ENDC						;FINALIZA C
	ORG		0			;INICIO DE 0
	GOTO	START		;CICLO O BUCLE
	ORG		5			;FIN EN 5
;CONFIGURACION****************************************************************
START		BSF		STATUS,5	;BANCO 1 ACTIVA EN BIT B DE F
			CLRF	TRISB		;PORTB ES LA SALIDA 
			MOVLW	0X1F		;MOVER A LA PARTE BAJA DEL REGISTRO DE MEMORIA RA0 RA4 SON LAS ENTRADAS DEL PIC
			MOVWF	TRISA		;MOVER A F A TRISA
			MOVLW	B'11000111'	;ASIGNA 256 AL TIMER
			MOVWF	OPTION_REG	;MUEVE AL REGISTRO DEL VALOR DEL TIMER
			BCF		STATUS,5	;CARGAR EL CONTENIDO DE LA POSICION 5 AL BANCO 0
			CLRW
			CLRF	NUMERO
;INICIO****************************************************************************
MAIN		MOVF	NUMERO,W	;TOMA LO QUE CONTIENE LA VARIABLE
			CALL	TABLA		;LLAMA A LA FUNCION QUE SE LLAMA TABLA
			MOVWF	PORTB		;MUESTRA EL VALOR QUE TOMO DE LA TABLA
			CALL	PAUSE_1000	;SE GENERA UNA PAUSA
			INCF	NUMERO,F	;REALIZA UN INCREMENTO DE LA VARIABLE EN F 
			MOVF	NUMERO,W	;SE CARGA LA VARIABLE W
			XORLW	0X10		;SE COMPARA SI ES QUE LLEGA AL REGISTRO 10
			BTFSS	STATUS,Z	;VERIFICAR SI HA LLEGADO
			GOTO	MAIN		;REALIZA UN BUCLE MAIN
			CLRW				;AL LLEGAR A 10 SE RESERBA A W
			CLRF	NUMERO		;SE LIMPIA LA VARIEDAD DE NUMERO
			GOTO	MAIN		;INDICA UN BUCLE
;FIN INICIO*************************************************************************
;RETARDO EN 1 SEGUNDO
PAUSE_1000	MOVLW	0X02		;SE LE ASIGNA 1000 AL CONTADOR
			MOVWF	CONTADOR	;MUEVE EL CONTADOR A F
DELAY		BCF		INTCON,T0IF	;SE LIBERA EL BIT DE DESBORDAMIENTO TMR0
			MOVLW	09			;SE CARGA EL 217
			MOVWF	TMR0		;A TMR0
DELAY2		BTFSS	INTCON,T0IF	;SE LIBERA EL BIT DE DESBORDAMIENTO TMR0
			GOTO	DELAY2		;BUCLE DE DELAY 2
			DECFSZ	CONTADOR,F	;DECREMENTA EN 1 EL CONTADOR
			GOTO	DELAY		;BUCLE EN DELAY
			RETURN				;REGRESA
;TABLA ******************************************************************************
TABLA		ADDWF	PCL,F		;SE INICIALIZA LA FUNCION TABLA CON LA QUE TRAE F
			RETLW	B'00111111'	;0
			RETLW	B'00000110'	;1
			RETLW	B'01011011'	;2
			RETLW	B'01001111'	;3
			RETLW	B'01100110'	;4
			RETLW	B'01101101'	;5
			RETLW	B'01111101'	;6
			RETLW	B'01000111'	;7
			RETLW	B'01111111'	;8
			RETLW 	B'01100111'	;9
								;HEXADECIMAL
			RETLW	B'01110111'	;A
			RETLW	B'01111100'	;b
			RETLW	B'00111001'	;C
			RETLW	B'01011110'	;d
			RETLW	B'01111001'	;E
			RETLW	B'01110001'	;F
	END

